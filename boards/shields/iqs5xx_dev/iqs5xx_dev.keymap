/*
 * Copyright (c) 2025 Mariano Uvalle
 *
 * SPDX-License-Identifier: MIT
 */

#include <behaviors.dtsi>
#include <dt-bindings/zmk/keys.h>

/ {
    keymap {
        compatible = "zmk,keymap";

        default_layer {
            bindings = < &kp SPACE >;
        };
    };
};
